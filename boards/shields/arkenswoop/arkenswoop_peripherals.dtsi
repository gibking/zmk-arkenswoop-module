#include "arkenswoop.dtsi"

/ {
	chosen {
		/*zephyr,display = &oled;*/
		zmk,kscan = &kscan0;
	};

	kscan0: kscan {        
		compatible = "zmk,kscan-gpio-matrix";
		label = "KSCAN";
		wakeup-source;
		diode-direction = "col2row";
		row-gpios
				= <&pro_micro 4 (GPIO_ACTIVE_HIGH | GPIO_PULL_DOWN)> // D4
				, <&pro_micro 5 (GPIO_ACTIVE_HIGH | GPIO_PULL_DOWN)> // C6
				, <&pro_micro 6 (GPIO_ACTIVE_HIGH | GPIO_PULL_DOWN)> // D7
				, <&pro_micro 7 (GPIO_ACTIVE_HIGH | GPIO_PULL_DOWN)> // E6
				;
	};
};
