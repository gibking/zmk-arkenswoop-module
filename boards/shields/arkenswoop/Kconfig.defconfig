## boards/shields/arkenswoop/Kconfig.defconfig
```kconfig
if SHIELD_ARKENSWOOP_DONGLE

config ZMK_KEYBOARD_NAME
    default "arkenswoopd"

config ZMK_SPLIT
    default y

config ZMK_SPLIT_ROLE_CENTRAL
    default y

config ZMK_SPLIT_BLE_CENTRAL_PERIPHERALS
    default 2

config BT_MAX_CONN
    default 7

config BT_MAX_PAIRED
    default 7

config DONGLE_SCREEN_AMBIENT_LIGHT
    default y

config DONGLE_SCREEN_SYSTEM_ICON
    default 1

endif

if SHIELD_ARKENSWOOP_LEFT || SHIELD_ARKENSWOOP_RIGHT

config ZMK_SPLIT
    default y

config ZMK_SPLIT_ROLE_CENTRAL
    default n

if ZMK_DISPLAY

config I2C
	default n

config SSD1306
	default n

endif # ZMK_DISPLAY

if LVGL

config LV_Z_VDB_SIZE
    default 64

config LV_Z_BITS_PER_PIXEL
    default 1

choice LV_COLOR_DEPTH
    default LV_COLOR_DEPTH_1
endchoice

endif # LVGL

endif
```
